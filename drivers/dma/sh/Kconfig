## drivers/dma/sh/Kconfig
```kconfig
#
# DMA engine configuration for sh
#

config RENESAS_DMA
	bool
	select DMA_ENGINE

config SH_DMAE_BASE
	bool "Renesas SuperH DMA Engine support"
	depends on (SUPERH && SH_DMA) || (ARM && ARCH_SHMOBILE)
	depends on !SH_DMA_API
	default y
	select RENESAS_DMA
	help
	  Enable support for the Renesas SuperH DMA controllers.

config SH_DMAE
	tristate "Renesas SuperH DMAC support"
	depends on SH_DMAE_BASE
	help
	  Enable support for the Renesas SuperH DMA controllers.

config SUDMAC
	tristate "Renesas SUDMAC support"
	depends on SH_DMAE_BASE
	help
	  Enable support for the Renesas SUDMAC controllers.

config RCAR_AUDMAC_PP
	tristate "Renesas R-Car Audio DMAC Peripheral Peripheral support"
	depends on SH_DMAE_BASE
	help
	  Enable support for the Renesas R-Car Audio DMAC Peripheral Peripheral controllers.

config RCAR_DMAC
	tristate "Renesas R-Car Gen2 DMA Controller"
	depends on ARCH_SHMOBILE || COMPILE_TEST
	select RENESAS_DMA
	help
	  This driver supports the general purpose DMA controller found in the
	  Renesas R-Car second generation SoCs.

config SHDMA_R8A73A4
	def_bool y
	depends on ARCH_R8A73A4 && SH_DMAE != n
```

## drivers/gpu/drm/rcar-du/Kconfig
```kconfig
config DRM_RCAR_DU
	tristate "DRM Support for R-Car Display Unit"
	depends on DRM && ARM
	select DRM_KMS_HELPER
	select DRM_KMS_CMA_HELPER
	select DRM_GEM_CMA_HELPER
	help
	  Choose this option if you have an R-Car chipset.
	  If M is selected the module will be called rcar-du-drm.

config DRM_RCAR_LVDS
	bool "R-Car DU LVDS Encoder Support"
	depends on DRM_RCAR_DU
	help
	  Enable support LVDS encoders.

	  If you want to access LVDS encoder, you select y.
	  If you don't want to access LVDS encoder, you select n.

config DRM_RCAR_DESKTOP_TURN_OFF
	bool "R-Car DU turn off desktop layer"
	depends on DRM_RCAR_DU && !DRM_RCAR_DU_CONNECT_VSP
	default n
	help
	  Choose this option if you want to turn off desktop layer.

	  If you want to turn off desktop layer, you select y.
	  If you want to turn on desktop layer, you select n.

config DRM_RCAR_ALPHA_BIT_ARGB1555
	int "R-Car DU alpha bit function of ARGB1555"
	depends on DRM_RCAR_DU && !DRM_RCAR_DU_CONNECT_VSP
	range 0 1
	default 0
	help
	  Choose this option if you select A bit function of ARGB1555.
	  If you set value to 0, pixel alpha blending is performed
	  when the value of A is 0.
	  If you set value to 1, pixel alpha blending is performed
	  when the value of A is 1.

config DRM_RCAR_DU_OVERLAY_CH
	hex "R-Car DU initial channel of overlay layers"
	range 0 0x3f
	default 0x3f
	depends on DRM_RCAR_DU && !DRM_RCAR_DU_CONNECT_VSP
	help
	  The value of configuration indicates initial channel of
	  overlay layers. Bit 0 shows overlay0 layer and it can
	  set up from overlay0 layer to overlay5 layer.
	  The initial channel of overlay layer is DU channel 0
	  when the value of bit is set as "0".
	  The initial channel of overlay layer is DU channel 1
	  when the value of bit is set as "1".

config DRM_RCAR_DU_CONNECT_VSP
	bool "R-Car DU VSP connection support"
	depends on DRM_RCAR_DU
	help
	  Enable support VSP connection.

	  If you want to connect VSP with DU, you select y.
	  If you don't want to connect VSP with DU, you select n.

config DRM_RCAR_DU0_USE_VSPDU_CH
	int "R-Car DU0 use VSPDU channel"
	depends on DRM_RCAR_DU && DRM_RCAR_DU_CONNECT_VSP
	default "0"
	help
	  Choose this option if DU0 select to use VSPDU channel.
	  If you set value to 0 or 2, DU0 is connected with VSPDU0.
	  If you set value to 1 or 3, DU0 is connected with VSPDU1.
	  If you set value to -1, DU0 is not connected with any VSPD.
	  When you set value to 2 or 3, VSPDU connection can be changed dynamically.

config DRM_RCAR_DU1_USE_VSPDU_CH
	int "R-Car DU1 use VSPDU channel"
	depends on DRM_RCAR_DU && DRM_RCAR_DU_CONNECT_VSP
	default "1"
	help
	  Choose this option if DU1 select to use VSPDU channel.
	  R8A7794 does not support VSPDU1.
	  If you set value to 0 or 2, DU1 is connected with VSPDU0.
	  If you set value to 1 or 3, DU1 is connected with VSPDU1.
	  If you set value to -1, DU1 is not connected with any VSPD.
	  When you set value to 2 or 3, VSPDU connection can be changed dynamically.

config DRM_RCAR_DU2_USE_VSPDU_CH
	int "R-Car DU2 use VSPDU channel"
	default "-1"
	depends on DRM_RCAR_DU && DRM_RCAR_DU_CONNECT_VSP
	help
	  Choose this option if DU2 select to use VSPDU channel.
	  Only R8A7790 can use DU2 connected by VSPDU1.
	  If you set value to 1 or 3, DU2 is connected with VSPDU1.
	  If you set value to -1, DU2 is not connected with any VSPD.
	  When you set value to 3 , VSPDU connection can be changed dynamically.

config DRM_RCAR_VSP_ALPHA_BIT_ARGB1555
	int "R-Car DU VSP alpha bit function of ARGB1555"
	depends on DRM_RCAR_DU && DRM_RCAR_DU_CONNECT_VSP
	range 0 1
	default 0
	help
	  Choose this option if you select A bit function of ARGB1555.
	  If you set value to 0, pixel alpha blending is performed
	  when the value of A is 0.
	  If you set value to 1, pixel alpha blending is performed
	  when the value of A is 1.
```

## drivers/mmc/core/Kconfig
```kconfig
#
# MMC core configuration
#

config MMC_UNSAFE_RESUME
	bool "Assume MMC/SD cards are non-removable (DANGEROUS)"
	help
	  If you say Y here, the MMC layer will assume that all cards
	  stayed in their respective slots during the suspend. The
	  normal behaviour is to remove them at suspend and
	  redetecting them at resume. Breaking this assumption will
	  in most cases result in data corruption.

	  This option is usually just for embedded systems which use
	  a MMC/SD card for rootfs. Most people should say N here.

	  This option sets a default which can be overridden by the
	  module parameter "removable=0" or "removable=1".

config MMC_CLKGATE
	bool "MMC host clock gating"
	help
	  This will attempt to aggressively gate the clock to the MMC card.
	  This is done to save power due to gating off the logic and bus
	  noise when the MMC card is not in use. Your host driver has to
	  support handling this in order for it to be of any use.

	  If unsure, say N.

config MMC_PASSWORDS
	boolean "MMC card lock/unlock passwords (EXPERIMENTAL)"
	select KEYS
	help
	  Say Y here to enable the use of passwords to lock and unlock
	  MMC cards. This uses the access key retention support, using
	  request_key to look up the key associated with each card.

	  For example, if you have an MMC card that was locked using
	  Symbian OS on your cell phone, you won't be able to read it
	  on Linux without this support.
```

## drivers/net/ethernet/renesas/Kconfig
```kconfig
#
# Renesas device configuration
#

config SH_ETH
	tristate "Renesas SuperH Ethernet support"
	depends on HAS_DMA
	select CRC32
	select NET_CORE
	select MII
	select MDIO_BITBANG
	select PHYLIB
	---help---
	  Renesas SuperH Ethernet device driver.
	  This driver supporting CPUs are:
		- SH7619, SH7710, SH7712, SH7724, SH7734, SH7763, SH7757,
		  R8A7740, R8A777x and R8A779x.

config RAVB
	tristate "Renesas Ethernet AVB Hardware support"
	depends on HAS_DMA
	select CRC32
	select NET_CORE
	select MII
	select MDIO_BITBANG
	select PHYLIB
	---help---
	  Renesas Ethernet AVB device driver.
	  This driver supporting CPUs are:
		- R8A779x.

if RAVB

config RAVB_PTP_1588_CLOCK
	bool "Renesas Ethernet AVB as PTP clock"
	depends on RAVB
	select PTP_1588_CLOCK
	default y
	help
	  This driver adds support for using the Renesas Ethernet
	  AVB as a PTP clock. This clock is only useful if your PTP
	  programs are getting hardware time stamps on the PTP
	  Ethernet packets using the SO_TIMESTAMPING API.

endif # CONFIG_RAVB
```

## drivers/pci/host/Kconfig
```kconfig
menu "PCI host controller drivers"
	depends on PCI

config PCI_MVEBU
	bool "Marvell EBU PCIe controller"
	depends on ARCH_MVEBU

config PCI_RCAR_GEN2
	bool "Renesas R-Car Gen2 Internal PCI controller"
	depends on ARCH_SHMOBILE || (ARM && COMPILE_TEST)
	select BOUNCE if HIGHMEM
	help
	  Say Y here if you want internal PCI support on R-Car Gen2 SoC.
	  There are 3 internal PCI controllers available with a single
	  built-in EHCI/OHCI host controller present on each one.

config PCI_RCAR_GEN2_PCIE
	bool "Renesas R-Car PCIe controller"
	depends on ARCH_SHMOBILE || (ARM && COMPILE_TEST)
	help
	  Say Y here if you want PCIe controller support on R-Car Gen2 SoCs.

endmenu
```
